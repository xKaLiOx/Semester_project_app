## boards/RokErnLin/semester_project/Kconfig.semester_project
```kconfig
config BOARD_SEMESTER_PROJECT
	select SOC_NRF54L05_CPUAPP if BOARD_SEMESTER_PROJECT_NRF54L05_CPUAPP
	select SOC_NRF54L05_CPUFLPR if \
		BOARD_SEMESTER_PROJECT_NRF54L05_CPUFLPR || \
		BOARD_SEMESTER_PROJECT_NRF54L05_CPUFLPR_XIP
```

## boards/RokErnLin/semester_project/board.yml
```yaml
board:
  name: semester_project
  vendor: RokErnLin
  socs:
  - name: nrf54l05
    variants:
    - name: xip
      cpucluster: cpuflpr
```
